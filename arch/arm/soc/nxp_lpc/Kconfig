## arch/arm/soc/nxp_lpc/Kconfig
```kconfig
#
# Copyright (C) 2016 Assured Information Security, Inc.
# Copyright (c) 2016 Intel Corporation
# Copyright (c) 2016, Freescale Semiconductor, Inc.
#
# Licensed under the Apache License, Version 2.0 (the "License");
# you may not use this file except in compliance with the License.
# You may obtain a copy of the License at
#
#     http://www.apache.org/licenses/LICENSE-2.0
#
# Unless required by applicable law or agreed to in writing, software
# distributed under the License is distributed on an "AS IS" BASIS,
# WITHOUT WARRANTIES OR CONDITIONS OF ANY KIND, either express or implied.
# See the License for the specific language governing permissions and
# limitations under the License.
#

config SOC_FAMILY_LPC
	bool
	# omit prompt to signify a "hidden" option
	default n

if SOC_FAMILY_LPC
config SOC_FAMILY
	string
	default "nxp_lpc"
endif

source "arch/arm/soc/nxp_lpc/*/Kconfig.soc"

config SOC_PART_NUMBER
	string
	default SOC_PART_NUMBER_LPC43XX if SOC_SERIES_LPC43XX
	help
	This string holds the full part number of the SoC. It is a hidden option
	that you should not set directly. The part number selection choice defines
	the default value for this string.


config XTAL_FREQUENCY
	int "Crystal Oscillator Frequency"
	default 12000000
	help
	The frequnecy of the crystal oscillator attached to the LPC chip, or 0
	if not using a crystal (e.g. using CLKIN or the internal oscillator).


config SYSCLK_FREQUENCY
  int "System Clock Frequency (in Hz)"
	default 204000000
	help
	The target frequency for the primary PLL, and main system clock.
	Should not exceed 204MHz.

config SYSCLK_DELTA
  int "System Clock Delta (in Hz)"
	default 0
	help
	The maximum clock offset from the SYSCLK_FREQUENCY allowed, in Hz. This
	is used to set a bound for PLL generation error. This can be zero, but if
	the SYSCLK_FREQUENCY target isn't meetable, the system will stall.

config CLKIN_FREQUENCY
	int "Clock Input Frequency"
	default 0
	help
	The frequency of the signal on the clkin pin, or 0 if the clkin pin is unused.
```

## arch/arm/soc/nxp_lpc/lpc43xx/Kconfig.soc
```kconfig
# Kconfig - NXP LPC43xx MCU Line
#
# Copyright (c) 2016 Kyle J. Temkin <kyle@ktemkin.com>
#
# Licensed under the Apache License, Version 2.0 (the "License");
# you may not use this file except in compliance with the License.
# You may obtain a copy of the License at
#
#     http://www.apache.org/licenses/LICENSE-2.0
#
# Unless required by applicable law or agreed to in writing, software
# distributed under the License is distributed on an "AS IS" BASIS,
# WITHOUT WARRANTIES OR CONDITIONS OF ANY KIND, either express or implied.
# See the License for the specific language governing permissions and
# limitations under the License.
#

choice
prompt "LPC43xx MCU Selection"
depends on SOC_SERIES_LPC43XX

config SOC_LPC4330
	bool "SOC_LPC4330"
endchoice


if SOC_SERIES_LPC43XX

config SOC_PART_NUMBER_LPC4330FBD144
	bool

config SOC_PART_NUMBER_LPC43XX
	string
	default "LPC4330FDB144" if SOC_PART_NUMBER_LPC4330FBD144
	help
	This string holds the full part number of the SoC. It is a hidden option
	that you should not set directly. The part number selection choice defines
	the default value for this string.

endif
```

## boards/greatfet_one/greatfet_one_defconfig
```kconfig
CONFIG_ARM=y
CONFIG_BOARD_GREATFET_ONE=y
CONFIG_SOC_FAMILY_LPC=y
CONFIG_SOC_SERIES_LPC43XX=y
CONFIG_SOC_LPC4330=y

CONFIG_SYS_CLOCK_HW_CYCLES_PER_SEC=204000000
CONFIG_CORTEX_M_SYSTICK=y
CONFIG_FLASH_SIZE=2048
CONFIG_XIP=y

# TODO: We currently specify 128KiB of the device's
# 264KiB, as that's the size of the first contiguous block,
# and it makes this work with the Zephyr linker script. We
# may want to reshape this eventually to take advantage of
# the device's entire SRAM.
CONFIG_SRAM_SIZE=128

CONFIG_CONSOLE=y
CONFIG_UART_CONSOLE=y
CONFIG_UART_LPC=y
CONFIG_SERIAL=y
```

## drivers/serial/Kconfig.lpc
```kconfig
menuconfig UART_LPC
	depends on LPCOPEN
	bool "Driver for LPC-chip UARTs"
	default y
	select SERIAL_HAS_DRIVER
	help
	  This option enables the LPC UART driver.

	  This driver is simply a shim driver based on the UART driver
	  provided by LPCOpen.

config UART_LPC_0
	depends on UART_LPC
	bool "Enable UART 0 controller"
	default y

config UART_LPC_0_NAME
	depends on UART_LPC_0
	string "UART_0 device name"
	default "UART_0"
	help
	  This option holds the UART_0 device name. If unsure, use the
	  default name.

config UART_LPC_0_BAUDRATE
	depends on UART_LPC_0
	int "UART_0 baud rate"
	default 115200
	help
	  This option sets the baud rate from the UART_0 device.


# TODO: Support more UARTs!:
```
